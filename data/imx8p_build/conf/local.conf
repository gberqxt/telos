## data/imx8p_build/conf/local.conf
```bitbake
MACHINE ??= 'imx8mpevk'
DISTRO ?= 'fsl-imx-wayland'
PACKAGE_CLASSES ?= 'package_rpm'
EXTRA_IMAGE_FEATURES ?= "debug-tweaks"
USER_CLASSES ?= "buildstats"
PATCHRESOLVE = "noop"
BB_DISKMON_DIRS ??= "\
    STOPTASKS,${TMPDIR},1G,100K \
    STOPTASKS,${DL_DIR},1G,100K \
    STOPTASKS,${SSTATE_DIR},1G,100K \
    STOPTASKS,/tmp,100M,100K \
    HALT,${TMPDIR},100M,1K \
    HALT,${DL_DIR},100M,1K \
    HALT,${SSTATE_DIR},100M,1K \
    HALT,/tmp,10M,1K"
PACKAGECONFIG:append:pn-qemu-system-native = " sdl"
CONF_VERSION = "2"
DL_DIR ?= "${BSPDIR}/downloads/"
ACCEPT_FSL_EULA = "1"
PACKAGE_CLASSES = "package_deb"
EXTRA_IMAGE_FEATURES += "package-management"
SERIAL_CONSOLES:forcevariable = "115200;ttymxc3"
SOC_ATF_BOOT_UART_BASE:mx8m-generic-bsp:forcevariable = "0x30a60000"
DISTRO_FEATURES:append = " tpm2"
CORE_IMAGE_EXTRA_INSTALL += "chromium-ozone-wayland"
CORE_IMAGE_EXTRA_INSTALL += " gstreamer1.0-libav gstreamer1.0 gstreamer1.0-plugins-base gstreamer1.0-plugins-good gstreamer1.0-plugins-bad ffmpeg"  
CORE_IMAGE_EXTRA_INSTALL += " apt gnupg liberation-fonts gawk e2fsprogs-resize2fs "
PACKAGECONFIG:append:pn-qtmultimedia = " gstreamer "
LICENSE_FLAGS_ACCEPTED = "commercial"
CORE_IMAGE_EXTRA_INSTALL += " kernel-module-snd-soc-inf1000"
MACHINE_FEATURES += "alsa"
IMAGE_INSTALL:append = " alsa-utils"
IMAGE_INSTALL:append = " sox"
IMAGE_INSTALL:append = " python3-flask"

# FPGA updater
IMAGE_INSTALL:append = " machxo-programmer"

# ethernet and MAC address configuration
IMAGE_INSTALL:append = " ethernet-config"


DL_DIR ?= "${BSPDIR}/downloads/"

# Switch to Debian packaging and include package-management in the image
PACKAGE_CLASSES = "package_deb"
EXTRA_IMAGE_FEATURES += "package-management"
```

## data/sources/meta-densitron/conf/layer.conf
```bitbake
# We have a conf and classes directory, add to BBPATH
BBPATH .= ":${LAYERDIR}"

# We have recipes-* directories, add to BBFILES
BBFILES += "${LAYERDIR}/recipes-*/*/*.bb \
            ${LAYERDIR}/recipes-*/*/*.bbappend"


BBFILE_COLLECTIONS += "meta-densitron"
BBFILE_PATTERN_meta-densitron = "^${LAYERDIR}/"
BBFILE_PRIORITY_meta-densitron = "9"

# Debug statement
# BB_ECHO := "${@bb.warn('DEBUG: Processing meta-densitron layer.conf')}"

LAYERDEPENDS_meta-densitron = " \
    core \
    freescale-layer \
"

LAYERSERIES_COMPAT_meta-densitron = "kirkstone"
```

## data/sources/meta-densitron/conf/machine/imx8mpevk.conf
```bitbake
#@TYPE: Machine
#@NAME: NXP i.MX8MP EVK
#@DESCRIPTION: Machine configuration for NXP i.MX8MP EVK with custom modifications

# Debug line to verify this file is read
BB_WARN := "${@bb.warn('DEBUG: Custom imx8mpevk.conf is being processed')}"

# Full set of machine overrides needed for i.MX8MP EVK
MACHINEOVERRIDES =. "aarch64:armv8a:use-nxp-bsp:imx-generic-bsp:imx-nxp-bsp:imxdrm:imxvpu:imxgpu:imxgpu2d:imxgpu3d:imxvulkan:mx8-generic-bsp:mx8-nxp-bsp:mx8m-generic-bsp:mx8m-nxp-bsp:mx8mp-generic-bsp:mx8mp-nxp-bsp:imx8mp-lpddr4-evk:imx8mpevk:"

# Your custom includes and modifications here
# Override serial console setting
SERIAL_CONSOLES:forcevariable = "115200;ttymxc3"

# Override UART base address
SOC_ATF_BOOT_UART_BASE:forcevariable = "0x30a60000"

# Include the inf1000 module for all images built for this machine
MACHINE_EXTRA_RDEPENDS += "kernel-module-snd-soc-inf1000"
```
